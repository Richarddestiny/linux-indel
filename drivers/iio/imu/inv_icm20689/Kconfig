## drivers/iio/imu/inv_icm20689/Kconfig
```kconfig
#
# inv-mpu6050 drivers for Invensense MPU devices and combos
#

config INV_ICM20689_IIO
	tristate "Invensense ICM20689 devices"
	depends on I2C && SYSFS
	select IIO_BUFFER
	select IIO_TRIGGERED_BUFFER
	help
	  This driver supports the Invensense ICM20689 devices.
	  This driver can also support ICM20689 in ICM20689 compatibility mode
	  and also in MPU6500 mode with some limitations.
	  It is a gyroscope/accelerometer combo device.
	  This driver can be built as a module. The module will be called
	  inv-icm20689.
```
